## boards/shields/macro/Kconfig.defconfig
```kconfig
if SHIELD_MACRO

config ZMK_KEYBOARD_NAME
    default "macro"

endif # SHIELD_MACRO
```

## boards/shields/macrotest/Kconfig.defconfig
```kconfig
if SHIELD_MACROTEST

config ZMK_KEYBOARD_NAME
    default "macrotest"

endif # SHIELD_MACROTEST
```
